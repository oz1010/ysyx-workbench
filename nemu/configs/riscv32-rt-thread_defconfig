## nemu/src/memory/Kconfig
```kconfig
menu "Memory Configuration"

choice
  prompt "Using memory type"
  default MEM_TYPE_MULTI
config MEM_TYPE_SINGLE
  bool "single"
config MEM_TYPE_MULTI
  bool "multi"
endchoice

if MEM_TYPE_SINGLE
config MBASE
  hex "Memory base address"
  default 0x0        if ISA_x86
  default 0x0
  
config MSIZE
  hex "Memory size"
  default 0x40000000
endif # end MEM_TYPE_SINGLE

config IMG_LOAD
  hex "Image load address from the base of memory"
  default 0x100000 if ISA_x86
  default MBASE if MEM_TYPE_SINGLE
  default 0x30000000 if MEM_TYPE_MULTI

choice
  prompt "Physical memory definition"
  default PMEM_MALLOC
config PMEM_MALLOC
  bool "Using malloc()"
config PMEM_GARRAY
  depends on !TARGET_AM
  bool "Using global array"
endchoice

config MEM_INIT_VALUE
  hex "Initialize the memory with specify values"
  default 0x5E
  help
    This may help to find undefined behaviors.

# config MEM_RANDOM
#   depends on MODE_SYSTEM && !DIFFTEST && !TARGET_AM
#   bool "Initialize the memory with random values"
#   default y
#   help
#     This may help to find undefined behaviors.

config DIFF_MSIZE
  hex "Memory size in differential testing"
  depends on DIFFTEST
  default 0x40000000

endmenu #MEMORY
```

## npc/configs/riscv32e-rt-thread_defconfig
```kconfig
CONFIG_DCACHE=y
CONFIG_ISA_RISCV_PIPELINE_CHISEL=y
# CONFIG_DEBUG_SYSTEM is not set
```

## npc/src/isa/riscv32/Kconfig
```kconfig
menu "RISC-V Processor Options"

choice 
    depends on ISA_riscv
    prompt "RISC-V Processor Type"
    default ISA_RISCV_PIPELINE

    config ISA_RISCV_SINGLE
        bool "single"
    config ISA_RISCV_MULTIPLE
        bool "multiple"
    config ISA_RISCV_PIPELINE
        bool "pipeline"
    config ISA_RISCV_PIPELINE_CHISEL
        bool "pipeline-chisel"
endchoice

menu "CSR Initial Values"
  config CSR_MSTATUS_INIT
      hex "Initial value of mstatus"
      default 0xa00001800 if RV64
      default 0x1800
  config CSR_MVENDORID_INIT
      hex "Value of mvendorid (read-only)"
      default 0x78797379
  config CSR_MARCHID_INIT
      hex "Value of marchid (read-only)"
      default 0x15FDF47
endmenu

menuconfig ICACHE
  bool "ICache enable"
  depends on !ISA_RISCV_SINGLE
  default y
  if ICACHE
    config ICACHE_PARAMETER_W
      int "ICache parameter W"
      default 8

    config ICACHE_PARAMETER_N
      int "ICache parameter N"
      default 4

    config ICACHE_PARAMETER_M
      int "ICache parameter M"
      default 4
  endif # ICACHE

menuconfig DCACHE
  bool "DCache enable"
  depends on !ISA_RISCV_SINGLE
  default n
  if DCACHE
    config DCACHE_PARAMETER_W
      int "DCache parameter W"
      default 8

    config DCACHE_PARAMETER_N
      int "DCache parameter N"
      default 4

    config DCACHE_PARAMETER_M
      int "DCache parameter M"
      default 4
  endif # DCACHE

config CHISEL_DIR_NAME
    string "Directory name for Chisel compilation"
    depends on ISA_RISCV_PIPELINE_CHISEL
    default pipeline-manual

config ISA
  string
  default "x86" if ISA_x86
  default "mips32" if ISA_mips32
  default "riscv32" if ISA_riscv && !RV64
  default "riscv64" if ISA_riscv &&  RV64
  default "loongarch32r" if ISA_loongarch32r
  default "none"

config ISA64
  depends on ISA_riscv && RV64
  bool
  default y

config CORE_FREQUENCY
    int "Frequency (Hz) of the core"
    default 97000000

config CORE_NUM
    int "Number of processor cores"
    default 1

config ADDR_WIDTH
    int
    depends on ISA_riscv
    default 64 if RV64
    default 32

config DATA_WIDTH
    int
    depends on ISA_riscv
    default 64 if RV64
    default 32

endmenu
```

## npc/src/memory/Kconfig
```kconfig
menu "Memory Configuration"

choice
  prompt "Using memory type"
  default MEM_TYPE_MULTI
config MEM_TYPE_SINGLE
  bool "single"
config MEM_TYPE_MULTI
  bool "multi"
endchoice

if MEM_TYPE_MULTI
menuconfig SRAM
  bool "SRAM memory"
  default y
  if SRAM
    config SRAM_BASE
      hex "SRAM memory base address"
      default 0x0f000000

    config SRAM_SIZE
      hex "SRAM memory size"
      default 0x00002000
  endif # SRAM

menuconfig MROM
  bool "MROM memory"
  default y
  if MROM
    config MROM_BASE
      hex "MROM memory base address"
      default 0x20000000

    config MROM_SIZE
      hex "MROM memory size"
      default 0x00001000
  endif # MROM

menuconfig FLASH
  bool "FLASH memory"
  default y
  if FLASH
    config FLASH_BASE
      hex "FLASH memory base address"
      default 0x30000000

    config FLASH_SIZE
      hex "FLASH memory size"
      default 0x01000000
  endif # FLASH

menuconfig PSRAM
  bool "PSRAM memory"
  default y
  if PSRAM
    config PSRAM_BASE
      hex "PSRAM memory base address"
      default 0x80000000

    config PSRAM_SIZE
      hex "PSRAM memory size"
      default 0x00400000
  endif # PSRAM

menuconfig SDRAM
  bool "SDRAM memory"
  default y
  if SDRAM
    config SDRAM_BASE
      hex "SDRAM memory base address"
      default 0xa0000000

    config SDRAM_SIZE
      hex "SDRAM memory size"
      default 0x04000000

    config SDRAM_FREQUENCY
      int "Frequency (Hz) of the sdram"
      default 167000000
  endif # SDRAM
endif # MEM_TYPE_MULTI

if MEM_TYPE_SINGLE
config MBASE
  hex "Memory base address"
  default 0x0        if ISA_x86
  default 0x0
  
config MSIZE
  hex "Memory size"
  default 0x40000000
endif # end MEM_TYPE_SINGLE

config IMG_LOAD
  hex "Image load address from the base of memory"
  default 0x100000 if ISA_x86
  default MBASE if MEM_TYPE_SINGLE
  default 0x30000000 if MEM_TYPE_MULTI

config FAST_LOAD
  bool "Image load to ram fastly"
  default false if ISA_x86
  default y

choice
  prompt "Physical memory definition"
  default PMEM_MALLOC
config PMEM_MALLOC
  bool "Using malloc()"
config PMEM_GARRAY
  depends on !TARGET_AM
  bool "Using global array"
endchoice

config MEM_INIT_VALUE
  hex "Initialize the memory with specify values"
  default 0x5E
  help
    This may help to find undefined behaviors.

# config MEM_RANDOM
#   depends on MODE_SYSTEM && !DIFFTEST && !TARGET_AM
#   bool "Initialize the memory with random values"
#   default y
#   help
#     This may help to find undefined behaviors.

config DIFF_MSIZE
  hex "Memory size in differential testing"
  depends on DIFFTEST
  default 0x40000000

endmenu #MEMORY
```
